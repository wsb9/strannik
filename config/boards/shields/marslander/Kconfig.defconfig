## config/boards/shields/marslander/Kconfig.defconfig
```kconfig
if SHIELD_MARSLANDER_LEFT

config ZMK_KEYBOARD_NAME
    default "Marslander"

config ZMK_SPLIT_BLE_ROLE_CENTRAL
    default y

endif

if SHIELD_MARSLANDER_RIGHT
config ZMK_SPLIT_BLE_ROLE_CENTRAL
    default n

endif

if SHIELD_MARSLANDER_LEFT || SHIELD_MARSLANDER_RIGHT

config ZMK_SPLIT
    default y

endif
```

## config/boards/shields/pinfinder/Kconfig.defconfig
```kconfig
if SHIELD_MARSLANDER_LEFT

config ZMK_KEYBOARD_NAME
    default "PinFinder"

config ZMK_SPLIT_BLE_ROLE_CENTRAL
    default y

endif

if SHIELD_MARSLANDER_LEFT || SHIELD_MARSLANDER_RIGHT

config ZMK_SPLIT
    default y

endif
```

## config/boards/shields/pinfinder/Kconfig.shield
```kconfig
config SHIELD_MARSLANDER_LEFT
    def_bool $(shields_list_contains,marslander_left)

config SHIELD_MARSLANDER_RIGHT
    def_bool $(shields_list_contains,marslander_right)
```

## config/boards/shields/strannik/Kconfig.defconfig
```kconfig
if SHIELD_STRANNIK_LEFT

config ZMK_KEYBOARD_NAME
    default "Strannik"

config ZMK_SPLIT_BLE_ROLE_CENTRAL
    default y

endif

if SHIELD_STRANNIK_RIGHT
config ZMK_SPLIT_BLE_ROLE_CENTRAL
    default n

endif

if SHIELD_STRANNIK_LEFT || SHIELD_STRANNIK_RIGHT

config ZMK_SPLIT
    default y

endif
```

## config/boards/shields/strannik/Kconfig.shield
```kconfig
config SHIELD_STRANNIK_LEFT
    def_bool $(shields_list_contains,strannik_left)

config SHIELD_STRANNIK_RIGHT
    def_bool $(shields_list_contains,strannik_right)
```
